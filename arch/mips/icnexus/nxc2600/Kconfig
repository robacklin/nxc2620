## arch/mips/icnexus/nxc2600/Kconfig
```kconfig
choice
	prompt "Machine type"
	depends on ICNEXUS_NXC2600
	default ICNEXUS_NXC2600_DVB2

config ICNEXUS_NXC2600_DVB2
	bool "NXC2600 DVB2"

config ICNEXUS_NXC2600_DVB3
	bool "NXC2600 DVB3"

endchoice


choice
        prompt "CPU type"
        depends on ICNEXUS_NXC2600
        default ICNEXUS_NXC2620

config ICNEXUS_NXC2610
        bool "NXC2610"

config ICNEXUS_NXC2620
        bool "NXC2620"

endchoice

config NXC2600_CPU_CLOCK
	int "CPU Speed"
	depends on ICNEXUS_NXC2600
	default 336000000

config NXC2600_EXTAL_CLOCK
	int "Extal clock"
	depends on ICNEXUS_NXC2600
	default 3686400
```

## sound/mips/Kconfig
```kconfig
# ALSA MIPS drivers

menu "ALSA MIPS devices"
	depends on SND!=n && MIPS

config SND_AU1X00
	tristate "Au1x00 AC97 Port Driver"
	depends on (SOC_AU1000 || SOC_AU1100 || SOC_AU1500) && SND
	select SND_PCM
	select SND_AC97_CODEC
	help
	  ALSA Sound driver for the Au1x00's AC97 port.

config SND_NXC2600_AC97
	tristate "NXC2600 AC97 Port Driver"
        depends on ICNEXUS_NXC2600 && SND
        select SND_PCM
        select SND_AC97_CODEC
        help
          ALSA Sound driver for the NXC2600's AC97 port.

endmenu
```
